/* USER CODE BEGIN Header */
/**
 ******************************************************************************
 * @file           : main.c
 * @brief          : Main program body
 ******************************************************************************
 ** This notice applies to any and all portions of this file
 * that are not between comment pairs USER CODE BEGIN and
 * USER CODE END. Other portions of this file, whether
 * inserted by the user or by software development tools
 * are owned by their respective copyright owners.
 *
 * COPYRIGHT(c) 2019 STMicroelectronics
 *
 * Redistribution and use in source and binary forms, with or without modification,
 * are permitted provided that the following conditions are met:
 *   1. Redistributions of source code must retain the above copyright notice,
 *      this list of conditions and the following disclaimer.
 *   2. Redistributions in binary form must reproduce the above copyright notice,
 *      this list of conditions and the following disclaimer in the documentation
 *      and/or other materials provided with the distribution.
 *   3. Neither the name of STMicroelectronics nor the names of its contributors
 *      may be used to endorse or promote products derived from this software
 *      without specific prior written permission.
 *
 * THIS SOFTWARE IS PROVIDED BY THE COPYRIGHT HOLDERS AND CONTRIBUTORS "AS IS"
 * AND ANY EXPRESS OR IMPLIED WARRANTIES, INCLUDING, BUT NOT LIMITED TO, THE
 * IMPLIED WARRANTIES OF MERCHANTABILITY AND FITNESS FOR A PARTICULAR PURPOSE ARE
 * DISCLAIMED. IN NO EVENT SHALL THE COPYRIGHT HOLDER OR CONTRIBUTORS BE LIABLE
 * FOR ANY DIRECT, INDIRECT, INCIDENTAL, SPECIAL, EXEMPLARY, OR CONSEQUENTIAL
 * DAMAGES (INCLUDING, BUT NOT LIMITED TO, PROCUREMENT OF SUBSTITUTE GOODS OR
 * SERVICES; LOSS OF USE, DATA, OR PROFITS; OR BUSINESS INTERRUPTION) HOWEVER
 * CAUSED AND ON ANY THEORY OF LIABILITY, WHETHER IN CONTRACT, STRICT LIABILITY,
 * OR TORT (INCLUDING NEGLIGENCE OR OTHERWISE) ARISING IN ANY WAY OUT OF THE USE
 * OF THIS SOFTWARE, EVEN IF ADVISED OF THE POSSIBILITY OF SUCH DAMAGE.
 *
 ******************************************************************************
 */
/* USER CODE END Header */

/* Includes ------------------------------------------------------------------*/
#include "main.h"
#include "can.h"
#include "dma.h"
#include "spi.h"
#include "tim.h"
#include "usart.h"
#include "gpio.h"

/* Private includes ----------------------------------------------------------*/
/* USER CODE BEGIN Includes */
#include "stdio.h"
#include "stdbool.h"
#include "lcd.h"
#include "SDCard.h"
/* USER CODE END Includes */

/* Private typedef -----------------------------------------------------------*/
/* USER CODE BEGIN PTD */

/* USER CODE END PTD */

/* Private define ------------------------------------------------------------*/
/* USER CODE BEGIN PD */

/* USER CODE END PD */

/* Private macro -------------------------------------------------------------*/
/* USER CODE BEGIN PM */

/* USER CODE END PM */

/* Private variables ---------------------------------------------------------*/

/* USER CODE BEGIN PV */
SDCard sd1(&hspi2, SD_CS_Pin, SD_CS_GPIO_Port);
const unsigned char gImage_demo[19200] = { /* 0XC0,0X01,0XE0,0X01,0X40,0X01, */
0XFF,0XFF,0XFF,0XFF,0XFF,0XFF,0XFF,0XFF,0XFF,0XFF,0XFF,0XFF,0XFF,0XFF,0XFF,0XFF,
0XFF,0XFF,0XFF,0XFF,0XFF,0XFF,0XFF,0XFF,0XFF,0XFF,0XFF,0XFF,0XFF,0XFF,0XFF,0XFF,
0XFF,0XFF,0XFF,0XFF,0XFF,0XFF,0XFF,0XFF,0XFF,0XFF,0XFF,0XFF,0XFF,0XFF,0XFF,0XFF,
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0XFF,0XFF,0XFF,0XFF,0XFF,0XFF,0XFF,0XFF,0XFF,0XFF,0XFF,0XFF,0XFF,0XFF,0XFF,0XFF,
};




volatile uint8_t led_dc[16] = {
		25,
		60,
		60,
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		10,
		55
};
uint8_t led_dc_in[16];
uint16_t LED[16];
GPIO_PinState xerr;

/* USER CODE END PV */

/* Private function prototypes -----------------------------------------------*/
void SystemClock_Config(void);
/* USER CODE BEGIN PFP */

/* USER CODE END PFP */

/* Private user code ---------------------------------------------------------*/
/* USER CODE BEGIN 0 */
void init_pins() {
	GPIO_InitTypeDef GPIO_InitStruct = { 0 };
	__HAL_RCC_GPIOA_CLK_ENABLE()
	;
	GPIO_InitStruct.Pin = LED_CLK_Pin | LED_MOSI_Pin;
	GPIO_InitStruct.Mode = GPIO_MODE_OUTPUT_PP;
	GPIO_InitStruct.Speed = GPIO_SPEED_FREQ_HIGH;
	HAL_GPIO_Init(GPIOA, &GPIO_InitStruct);

	GPIO_InitStruct.Pin = LED_MISO_Pin;
	GPIO_InitStruct.Mode = GPIO_MODE_INPUT;
	GPIO_InitStruct.Pull = GPIO_NOPULL;
	HAL_GPIO_Init(LED_MISO_GPIO_Port, &GPIO_InitStruct);

	GPIO_InitStruct.Pin = LED_GS_Pin;
	GPIO_InitStruct.Mode = GPIO_MODE_OUTPUT_PP;
	GPIO_InitStruct.Speed = GPIO_SPEED_FREQ_LOW;
	HAL_GPIO_Init(LED_GS_GPIO_Port, &GPIO_InitStruct);
}
int _write(int file, char *ptr, int len) {
	while (huart3.gState != HAL_UART_STATE_READY)
		;
	HAL_UART_Transmit_DMA(&huart3, (uint8_t*) ptr, len);
	return len;
}

void TLC5940_clock_out_dc(void) {
	HAL_GPIO_WritePin(LED_VPRG_GPIO_Port, LED_VPRG_Pin, GPIO_PIN_SET);
	HAL_GPIO_WritePin(LED_DCPRG_GPIO_Port, LED_DCPRG_Pin, GPIO_PIN_SET);
	for (int i = 0; i < 16; i++) {
		for (int j = 5; j >= 0; j--) {
			if (led_dc[i] & (1 << j)) {
				HAL_GPIO_WritePin(LED_MOSI_GPIO_Port, LED_MOSI_Pin,
						GPIO_PIN_SET);
			} else {
				HAL_GPIO_WritePin(LED_MOSI_GPIO_Port, LED_MOSI_Pin,
						GPIO_PIN_RESET);
			}
			HAL_GPIO_WritePin(LED_CLK_GPIO_Port, LED_CLK_Pin, GPIO_PIN_SET);
			HAL_GPIO_WritePin(LED_CLK_GPIO_Port, LED_CLK_Pin, GPIO_PIN_RESET);
			led_dc_in[i] |= HAL_GPIO_ReadPin(LED_MISO_GPIO_Port, LED_MISO_Pin)<<j;
		}
	}
	HAL_GPIO_WritePin(LED_XLAT_GPIO_Port, LED_XLAT_Pin, GPIO_PIN_SET);
	HAL_GPIO_WritePin(LED_XLAT_GPIO_Port, LED_XLAT_Pin, GPIO_PIN_RESET);
}


void led_update_pwm() {
	uint8_t firstCycleFlag = 0;
	if (HAL_GPIO_ReadPin(LED_VPRG_GPIO_Port, LED_VPRG_Pin) == GPIO_PIN_SET) {
		HAL_GPIO_WritePin(LED_VPRG_GPIO_Port, LED_VPRG_Pin, GPIO_PIN_RESET);
		firstCycleFlag = 1;
	}
	uint16_t GSCLK_Counter = 0;
	uint16_t Data_Counter = 0;
	HAL_GPIO_WritePin(LED_BLANK_GPIO_Port, LED_BLANK_Pin, GPIO_PIN_RESET);
	while (true) {
		if(GSCLK_Counter > 4095){
			HAL_GPIO_WritePin(LED_BLANK_GPIO_Port, LED_BLANK_Pin, GPIO_PIN_SET);
			HAL_GPIO_WritePin(LED_XLAT_GPIO_Port, LED_XLAT_Pin, GPIO_PIN_SET);
			HAL_GPIO_WritePin(LED_XLAT_GPIO_Port, LED_XLAT_Pin, GPIO_PIN_RESET);
			if (firstCycleFlag) {
				HAL_GPIO_WritePin(LED_XLAT_GPIO_Port, LED_XLAT_Pin, GPIO_PIN_SET);
				HAL_GPIO_WritePin(LED_XLAT_GPIO_Port, LED_XLAT_Pin, GPIO_PIN_RESET);
				firstCycleFlag = 0;
			}
			break;
		}else {
			if (!(Data_Counter > 192 - 1)) {
				if (LED[Data_Counter/12] & (1<<(Data_Counter%12))){
					HAL_GPIO_WritePin(LED_MOSI_GPIO_Port, LED_MOSI_Pin, GPIO_PIN_SET);
				}else{
					HAL_GPIO_WritePin(LED_MOSI_GPIO_Port, LED_MOSI_Pin, GPIO_PIN_RESET);
				}
				HAL_GPIO_WritePin(LED_CLK_GPIO_Port, LED_CLK_Pin, GPIO_PIN_SET);
				HAL_GPIO_WritePin(LED_CLK_GPIO_Port, LED_CLK_Pin, GPIO_PIN_RESET);
				Data_Counter++;
			}
		}
		HAL_GPIO_WritePin(LED_GS_GPIO_Port, LED_GS_Pin, GPIO_PIN_SET);
		HAL_GPIO_WritePin(LED_GS_GPIO_Port, LED_GS_Pin, GPIO_PIN_RESET);
		GSCLK_Counter++;
	}
}
void TLC5940_Init(void) {
	HAL_GPIO_WritePin(LED_GS_GPIO_Port, LED_GS_Pin, GPIO_PIN_RESET);
	HAL_GPIO_WritePin(LED_CLK_GPIO_Port, LED_CLK_Pin, GPIO_PIN_RESET);
	HAL_GPIO_WritePin(LED_DCPRG_GPIO_Port, LED_DCPRG_Pin, GPIO_PIN_RESET);
	HAL_GPIO_WritePin(LED_VPRG_GPIO_Port, LED_VPRG_Pin, GPIO_PIN_SET);
	HAL_GPIO_WritePin(LED_XLAT_GPIO_Port, LED_XLAT_Pin, GPIO_PIN_RESET);
	HAL_GPIO_WritePin(LED_BLANK_GPIO_Port, LED_BLANK_Pin, GPIO_PIN_SET);
}
/* USER CODE END 0 */

/**
 * @brief  The application entry point.
 * @retval int
 */
int main(void) {
	/* USER CODE BEGIN 1 */
//uint32_t i = 0, j = 0;

	bool status = true;
	uint32_t counter1=0;
	uint8_t counter2=0;
	/* USER CODE END 1 */

	/* MCU Configuration--------------------------------------------------------*/

	/* Reset of all peripherals, Initializes the Flash interface and the Systick. */
	HAL_Init();

	/* USER CODE BEGIN Init */

	/* USER CODE END Init */

	/* Configure the system clock */
	SystemClock_Config();

	/* USER CODE BEGIN SysInit */

	/* USER CODE END SysInit */
	image_begin_sector = 5;
	for(int i = 0; i<20;i++){
		sd.read_block(image_begin_sector + i, &buff[512*i]);
	}
	/* Initialize all configured peripherals */
	MX_GPIO_Init();
	MX_DMA_Init();
	MX_USART3_UART_Init();
	MX_SPI2_Init();
	MX_CAN_Init();
	MX_SPI1_Init();
	//MX_TIM2_Init();
	/* USER CODE BEGIN 2 */
	lcd_init();
	lcd_clr_fast(WHITE);
	lcd_write_buff_fast_mono(gImage_demo,0,0,480,320);
	status = sd1.initalize();
	if (!status) {
		Error_Handler();
	}
	for (int i = 0; i < 16; i++) {
		LED[i] = 0;
	}
	for(int i = 0; i < 16; i++){
		led_dc[i] = 63;
	}

	init_pins();
	TLC5940_clock_out_dc();
	TLC5940_clock_out_dc();
	/* USER CODE END 2 */

	/* Infinite loop */
	/* USER CODE BEGIN WHILE */
	while (1) {
		led_update_pwm();
		if(HAL_GetTick()-counter1>500){
			counter1 = HAL_GetTick();
			if(counter2 > 8){
				LED[counter2] = 0xFFF;
			}else{
				LED[counter2] = 0xFFF;
			}
			if(counter2 == 0){
				LED[15] = 0;
			}else{
				LED[counter2-1] = 0;
			}
			counter2 = (counter2+1)%16;

		}
	}
	/* USER CODE END 3 */
}

/**
 * @brief System Clock Configuration
 * @retval None
 */
void SystemClock_Config(void) {
	RCC_OscInitTypeDef RCC_OscInitStruct = { 0 };
	RCC_ClkInitTypeDef RCC_ClkInitStruct = { 0 };

	/**Initializes the CPU, AHB and APB busses clocks
	 */
	RCC_OscInitStruct.OscillatorType = RCC_OSCILLATORTYPE_HSI;
	RCC_OscInitStruct.HSIState = RCC_HSI_ON;
	RCC_OscInitStruct.HSICalibrationValue = RCC_HSICALIBRATION_DEFAULT;
	RCC_OscInitStruct.PLL.PLLState = RCC_PLL_ON;
	RCC_OscInitStruct.PLL.PLLSource = RCC_PLLSOURCE_HSI_DIV2;
	RCC_OscInitStruct.PLL.PLLMUL = RCC_PLL_MUL16;
	if (HAL_RCC_OscConfig(&RCC_OscInitStruct) != HAL_OK) {
		Error_Handler();
	}
	/**Initializes the CPU, AHB and APB busses clocks
	 */
	RCC_ClkInitStruct.ClockType = RCC_CLOCKTYPE_HCLK | RCC_CLOCKTYPE_SYSCLK
			| RCC_CLOCKTYPE_PCLK1 | RCC_CLOCKTYPE_PCLK2;
	RCC_ClkInitStruct.SYSCLKSource = RCC_SYSCLKSOURCE_PLLCLK;
	RCC_ClkInitStruct.AHBCLKDivider = RCC_SYSCLK_DIV1;
	RCC_ClkInitStruct.APB1CLKDivider = RCC_HCLK_DIV2;
	RCC_ClkInitStruct.APB2CLKDivider = RCC_HCLK_DIV1;

	if (HAL_RCC_ClockConfig(&RCC_ClkInitStruct, FLASH_LATENCY_2) != HAL_OK) {
		Error_Handler();
	}
}

/* USER CODE BEGIN 4 */

/* USER CODE END 4 */

/**
 * @brief  This function is executed in case of error occurrence.
 * @retval None
 */
void Error_Handler(void) {
	/* USER CODE BEGIN Error_Handler_Debug */
	/* User can add his own implementation to report the HAL error return state */

	/* USER CODE END Error_Handler_Debug */
}

#ifdef  USE_FULL_ASSERT
/**
 * @brief  Reports the name of the source file and the source line number
 *         where the assert_param error has occurred.
 * @param  file: pointer to the source file name
 * @param  line: assert_param error line source number
 * @retval None
 */
void assert_failed(uint8_t *file, uint32_t line)
{
	/* USER CODE BEGIN 6 */
	/* User can add his own implementation to report the file name and line number,
	 tex: printf("Wrong parameters value: file %s on line %d\r\n", file, line) */
	/* USER CODE END 6 */
}
#endif /* USE_FULL_ASSERT */

/************************ (C) COPYRIGHT STMicroelectronics *****END OF FILE****/
